## layers/meta-balena-5x-owa/conf/layer.conf
```bitbake
# We have a conf and classes directory, add to BBPATH
BBPATH .= ":${LAYERDIR}"

# We have a packages directory, add to BBFILES
BBFILES += "${LAYERDIR}/recipes-*/*/*.bb \
            ${LAYERDIR}/recipes-*/*/*.bbappend"

BBFILE_COLLECTIONS += "balena-5x-owa"
BBFILE_PATTERN_balena-5x-owa := "^${LAYERDIR}/"
BBFILE_PRIORITY_balena-5x-owa = "9"

LAYERSERIES_COMPAT_balena-5x-owa += "zeus dunfell kirkstone"

KERNEL_IMAGETYPE:owa5x = "Image.gz"
```

## layers/meta-balena-5x-owa/conf/machine/owa5x.conf
```bitbake
#@TYPE: Machine
#@NAME: Owasys owa5x
#@SOC: i.MX8 MP
#@DESCRIPTION: Machine configuration for Owasys owa5x
#@MAINTAINER: Alvaro Guzman <alvaro.guzman@owasys.com>

MACHINEOVERRIDES =. "owa5x-nand:"

require conf/machine/owa5x-nand.conf
```
